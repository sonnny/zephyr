## CMakeLists.txt
```
# Minimum CMake required version
cmake_minimum_required( VERSION 3.20.0 )

set(OPENOCD /usr/local/bin/openocd)
set(OPENOCD_DEFAULT_PATH /home/sonny/pico/openocd)

set(ZEPHYR_EXTRA_MODULES "${CMAKE_SOURCE_DIR}/drivers/motor")
find_package(Zephyr REQUIRED HINTS $ENV{ZEPHYR_BASE})

# Project and source files
project(demo)
target_sources(app PRIVATE src/main.c)
```

## prj.conf
```kconfig
CONFIG_NO_OPTIMIZATIONS=y
CONFIG_GPIO=y
CONFIG_PWM=y
CONFIG_MOTOR=y
```

## dts/bindings/motor.yaml
```yaml
description: motor controller phase enable
compatible: "motor"
properties:
  gpios:
    type: phandle-array
    required: true
    description: phase pin forward / reverse

  pwms:
    type: phandle-array
    required: true
    description: use for speed variation
```

## src/main.c
```c
/*
 * demo for zephyr motor driver
 *   using phase and enable pins only
 *   like: cytron md13s
 *
 * motor_speed second argument is percentange 0 - 100
 *   depending on the motor and battery you may have to
 *   adjust the percentage before the motor start turning
 *
 * motor_rotate takes a boolean for second argument
 *   true to turn one way
 *   false to turn the opposite way
 *
 * to stop the motor just send zero percent to motor speed
 * see overlay file to see pin assignments
 * tested on an rp2040
 */

#include <zephyr/kernel.h>
#include <zephyr/drivers/gpio.h>
#include <zephyr/drivers/pwm.h>
#include "motor.h"

const struct device *motor = DEVICE_DT_GET(DT_NODELABEL(mymotor)); 

int main(void){
  motor_speed(motor, 60); // 60 lowest to turn on test motor
  while(true){
    motor_rotate(motor, true); // clockwise
    k_msleep(2000);
    motor_rotate(motor, false); // counter-clockwise
    k_msleep(2000);} 
 return 0;}
```
