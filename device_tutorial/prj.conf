## CMakeLists.txt
```
# Minimum CMake required version
cmake_minimum_required( VERSION 3.20.0 )

# register new module and keep your app sources properly defined
# ZEPHYR_EXTRA_MODULES tells the build system to include your drivers/simple_leds
# directory as external zephyr module
set(ZEPHYR_EXTRA_MODULES "${CMAKE_SOURCE_DIR}/drivers/simple_leds")
find_package(Zephyr REQUIRED HINTS $ENV{ZEPHYR_BASE})

# Project and source files
project(demo)
target_sources(app PRIVATE src/main.c)
```

## prj.conf
```kconfig
# Disable optimizations
CONFIG_NO_OPTIMIZATIONS=y
# Include GPIO drivers in system config (KCONFIG)
CONFIG_GPIO=y

# line below enables our device driver
CONFIG_SIMPLE_LEDS=y
```

## boards/maker_pi_rp2040.overlay
```dts
 / {
    myLed: myLed{
        compatible = "simple,leds";
        gpios = <&gpio0 6 GPIO_ACTIVE_HIGH>;
        label = "Blue led";
        delay = <20>;
    };
};
```

## dts/bindings/simple,leds.yaml
```yaml
# binding description
description: Led conencted to a pin for multipurpose

# binding name (this is the one will be used in the device tree file)
compatible: "simple,leds"

#child-binding:
  # properties our node will have, in our case there is just one called gpios
  # which will be mandatory and their values are in a multi type array
properties:
  gpios:
    type: phandle-array
    required: true
    description: The GPIO pin connected to a simple led.
  label:
    type: string
    description: just a name you can use for debugging
  delay:
    type: int
    description: blink delay in milliseconds
```

## src/main.c
```c
#include <zephyr/kernel.h>
#include <zephyr/drivers/gpio.h>
#include "simple_leds.h"

const struct device *led_dev0 = DEVICE_DT_GET( DT_NODELABEL(myled) ); 

int main(void)
{   
    while(true)
    {
        simple_leds_toggle(led_dev0);
        k_msleep(1000);
    }
        
	return 0;
}
```
